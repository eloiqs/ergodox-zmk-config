## config/west.yml
```yaml
manifest:
  remotes:
    - name: slicemk
      url-base: https://github.com/slicemk
  projects:
    - name: zmk
      remote: slicemk
      revision: v20230228-timeout4s
      import: app/west.yml
  self:
    path: config
```
